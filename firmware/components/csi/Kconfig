## firmware/components/csi/Kconfig
```kconfig
menu "SafeSense CSI"

config SAFESENSE_CSI_TFLM_MODEL
    bool "Enable released WISDOM48 INT8 TFLite Micro model"
    default n
    help
        Enable only after generating model/wisdom48_model_data.h and
        model/wisdom48_normalization.h from a tested release manifest.

endmenu
```

## firmware/csi_receiver/main/Kconfig.projbuild
```kconfig
menu "SafeSense CSI receiver network"

config SAFESENSE_WIFI_SSID
    string "Wi-Fi SSID"
    default ""

config SAFESENSE_WIFI_PASSWORD
    string "Wi-Fi password"
    default ""

endmenu
```

## firmware/csi_transmitter/main/Kconfig.projbuild
```kconfig
menu "SafeSense CSI transmitter network"

config SAFESENSE_WIFI_SSID
    string "Wi-Fi SSID"
    default ""

config SAFESENSE_WIFI_PASSWORD
    string "Wi-Fi password"
    default ""

config SAFESENSE_RECEIVER_IP
    string "CSI receiver IPv4 address"
    default "192.168.1.50"

endmenu
```

## firmware/environmental_node/main/Kconfig.projbuild
```kconfig
menu "SafeSense environmental node"

config SAFESENSE_WIFI_SSID
    string "Wi-Fi SSID"
    default ""

config SAFESENSE_WIFI_PASSWORD
    string "Wi-Fi password"
    default ""

config SAFESENSE_MQTT_BROKER_URI
    string "MQTT broker URI"
    default "mqtt://192.168.1.2:1883"

config SAFESENSE_DEVICE_ID
    string "Device ID"
    default "safesense-env-01"

config SAFESENSE_SAMPLE_INTERVAL_SECONDS
    int "Telemetry interval in seconds"
    range 2 3600
    default 10

endmenu
```

## firmware/node1_sensor_tx/main/Kconfig.projbuild
```kconfig
menu "SafeSense TX node"

config SAFESENSE_TX_DIRECT_LAPTOP_AP
    bool "Use this ESP32 as a Wi-Fi access point for direct laptop delivery"
    default y

config SAFESENSE_TX_LAPTOP_AP_SSID
    string "Direct laptop Wi-Fi network name"
    default "SafeSense-TX-Laptop"
    depends on SAFESENSE_TX_DIRECT_LAPTOP_AP

config SAFESENSE_TX_LAPTOP_AP_PASSWORD
    string "Direct laptop Wi-Fi network password (demo only)"
    default "SafeSenseDemo24"
    depends on SAFESENSE_TX_DIRECT_LAPTOP_AP

config SAFESENSE_TX_LAPTOP_HTTP_PORT
    int "Laptop HTTP receiver port"
    range 1024 65535
    default 8765
    depends on SAFESENSE_TX_DIRECT_LAPTOP_AP

config SAFESENSE_TX_WIFI_SSID
    string "Wi-Fi SSID"
    default ""

config SAFESENSE_TX_WIFI_PASSWORD
    string "Wi-Fi password"
    default ""

config SAFESENSE_TX_DEVICE_ID
    string "TX device ID"
    default "safesense-tx-01"

config SAFESENSE_TX_RX_HTTP_URL
    string "RX HTTP environment endpoint URL"
    default ""

config SAFESENSE_TX_RX_UDP_IP
    string "RX IPv4 address for CSI probe packets"
    default ""

config SAFESENSE_TX_CSI_PROBE_INTERVAL_MS
    int "CSI UDP probe interval in milliseconds"
    range 1 1000
    default 20

config SAFESENSE_TX_SAMPLE_INTERVAL_SECONDS
    int "Sensor sample interval in seconds"
    range 2 3600
    default 10

config SAFESENSE_FORECAST_ROOM
    int "Synthetic forecast model room index (0 cold, 1 lab, 2 classroom, 3 bakery, 4 server)"
    range 0 4
    default 0

config SAFESENSE_TX_SCENARIO_SERIAL_DEMO
    bool "Enable USB serial synthetic scenario playback mode"
    default n
    help
        Replaces real sensor sampling with labelled synthetic readings sent on
        UART0 by the dashboard. The fault flag skips the TX HTTP attempt; it
        does not physically turn the Wi-Fi radio off. For demonstrations only.

endmenu
```

## firmware/node1_sensor_tx/sdkconfig.defaults
```kconfig
CONFIG_SAFESENSE_TX_WIFI_SSID="SafeSense-RX-V1"
CONFIG_SAFESENSE_TX_DIRECT_LAPTOP_AP=y
CONFIG_SAFESENSE_TX_LAPTOP_AP_SSID="SafeSense-TX-Laptop"
CONFIG_SAFESENSE_TX_LAPTOP_AP_PASSWORD="SafeSenseDemo24"
CONFIG_SAFESENSE_TX_LAPTOP_HTTP_PORT=8765
CONFIG_SAFESENSE_TX_WIFI_PASSWORD="SafeSenseDemo24"
CONFIG_SAFESENSE_TX_RX_HTTP_URL="http://192.168.4.1/api/v1/tx/environment"
CONFIG_SAFESENSE_TX_RX_UDP_IP="192.168.4.1"
CONFIG_ESP_MAIN_TASK_STACK_SIZE=12288
CONFIG_BT_ENABLED=y
CONFIG_BT_BLUEDROID_ENABLED=y
CONFIG_BT_CLASSIC_ENABLED=y
CONFIG_BT_SPP_ENABLED=y
# CONFIG_BT_BLE_ENABLED is not set
CONFIG_BTDM_CTRL_MODE_BR_EDR_ONLY=y
CONFIG_ESP_COEX_SW_COEXIST_ENABLE=y
CONFIG_PARTITION_TABLE_CUSTOM=y
CONFIG_PARTITION_TABLE_CUSTOM_FILENAME="partitions_forecast.csv"
```

## firmware/node2_csi_gateway/main/Kconfig.projbuild
```kconfig
menu "SafeSense RX gateway"

config SAFESENSE_RX_AP_SSID
    string "RX Wi-Fi AP SSID"
    default "SafeSense-RX-V1"

config SAFESENSE_RX_AP_PASSWORD
    string "RX Wi-Fi AP password (demo only; change outside lab)"
    default "SafeSenseDemo24"

config SAFESENSE_RX_DEVICE_ID
    string "RX device ID"
    default "safesense-rx-01"

endmenu
```

## firmware/node2_csi_gateway/sdkconfig.defaults
```kconfig
CONFIG_ESP_WIFI_CSI_ENABLED=y
CONFIG_ESP_CONSOLE_UART_CUSTOM=y
CONFIG_ESP_CONSOLE_UART_BAUDRATE=460800
```
